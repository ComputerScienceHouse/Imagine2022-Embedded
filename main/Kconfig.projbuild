## main/Kconfig.projbuild
```kconfig
menu "Main"
    config HEARTBEAT_INTERVAL
        int "heartbeat interval (seconds)"
        range 0 300
        default 15
        help
            Time interval (in seconds) between sending heartbeat messages to the ingestion server
endmenu
```

## sdkconfig.defaults
```kconfig
CONFIG_BT_ENABLED=y
CONFIG_BTDM_CTRL_MODE_BLE_ONLY=y
CONFIG_BTDM_CTRL_MODE_BR_EDR_ONLY=n
CONFIG_BTDM_CTRL_MODE_BTDM=n
CONFIG_BT_CLASSIC_ENABLED=n
CONFIG_BT_A2DP_ENABLE=n
CONFIG_BT_BLE_ENABLED=y

# Fuck, gotta make the partition table bigger because I suck at coding.
CONFIG_PARTITION_TABLE_CUSTOM=y
CONFIG_PARTITION_TABLE_CUSTOM_FILENAME="partitions.csv"
CONFIG_PARTITION_TABLE_FILENAME="partitions.csv"

# LWIP is the bane of my existence
CONFIG_LWIP_IP_FORWARD=y
CONFIG_LWIP_IPV4_NAPT=y
CONFIG_LWIP_L2_TO_L3_COPY=y
```
